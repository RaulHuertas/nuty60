## boards/shields/nuty60/Kconfig.shield
```kconfig
# No whitespace after the comma or in your part name!
config SHIELD_NUTY60_LEFT
    def_bool $(shields_list_contains,nuty60_left)

# No whitespace after the comma or in your part name!
config SHIELD_NUTY60_RIGHT
    def_bool $(shields_list_contains,nuty60_right)

# No whitespace after the comma or in the keyboard name!
config SHIELD_NUTY60_DONGLE
    def_bool $(shields_list_contains,nuty60_dongle)
```
